#include <behaviors.dtsi>
#include <dt-bindings/zmk/keys.h>
#include <dt-bindings/zmk/bt.h>

/ {
    keymap {
        compatible = "zmk,keymap";

        default_layer { // Layer 0
            // -------------------------------------
            // |     Z     |     M     |
            bindings = <
//                &kp SPACE    &kp ENTER
                &kp SPACE    &kp S
            >;
        };
    };
 };
